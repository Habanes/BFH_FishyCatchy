## sdkconfig.defaults
```kconfig
# WiFi AP defaults
CONFIG_ESP_WIFI_SOFTAP_SUPPORT=y
CONFIG_ESP_WIFI_TX_BA_WIN=6

# HTTP server
CONFIG_HTTPD_MAX_REQ_HDR_LEN=1024
CONFIG_HTTPD_MAX_URI_LEN=256

# Keep logs lightweight in production-like operation
CONFIG_LOG_DEFAULT_LEVEL_INFO=y
```
